/* Copyright (c) 2015-2017, The Linux Foundation. All rights reserved.
 *
 * This program is free software; you can redistribute it and/or modify
 * it under the terms of the GNU General Public License version 2 and
 * only version 2 as published by the Free Software Foundation.
 *
 * This program is distributed in the hope that it will be useful,
 * but WITHOUT ANY WARRANTY; without even the implied warranty of
 * MERCHANTABILITY or FITNESS FOR A PARTICULAR PURPOSE.  See the
 * GNU General Public License for more details.
 */

&mdss_mdp {
		dsi_samsung_oneplus_dsc_cmd: qcom,mdss_dsi_samsung_oneplus_dsc_cmd {
		qcom,mdss-dsi-panel-name = "samsung dsc cmd mode oneplus dsi panel";
		qcom,mdss-dsi-panel-manufacture = "SAMSUNG";
		qcom,mdss-dsi-panel-version = "DSC";
		qcom,mdss-dsi-backlight-version = "SAMSUNG";
		qcom,mdss-dsi-backlight-manufacture = "SAMSUNG";
		qcom,mdss-dsi-panel-type = "dsi_cmd_mode";
		qcom,mdss-dsi-virtual-channel-id = <0>;
		qcom,mdss-dsi-stream = <0>;
		qcom,mdss-dsi-bpp = <24>;
		qcom,mdss-dsi-underflow-color = <0xff>;
		qcom,mdss-dsi-border-color = <0>;
		qcom,mdss-dsi-reset-sequence = <1 10>, <0 10>, <1 20>;
		qcom,mdss-dsi-traffic-mode = "burst_mode";
		qcom,mdss-dsi-bllp-eof-power-mode;
		qcom,mdss-dsi-bllp-power-mode;
		qcom,mdss-dsi-lane-0-state;
		qcom,mdss-dsi-lane-1-state;
		qcom,mdss-dsi-lane-2-state;
		qcom,mdss-dsi-lane-3-state;
		qcom,mdss-dsi-dma-trigger = "trigger_sw";
		qcom,mdss-dsi-mdp-trigger = "none";
		qcom,mdss-dsi-te-pin-select = <1>;
		qcom,mdss-dsi-wr-mem-start = <0x2c>;
		qcom,mdss-dsi-wr-mem-continue = <0x3c>;
		qcom,mdss-dsi-te-dcs-command = <1>;
		qcom,mdss-dsi-bl-min-level = <1>;
		qcom,mdss-dsi-bl-max-level = <1023>;
		qcom,mdss-brightness-max-level = <1023>;
		qcom,mdss-pan-physical-width-dimension = <65>; 
		qcom,mdss-pan-physical-height-dimension = <133>; 						
		qcom,mdss-dsi-init-delay-us = <1000>;					
		qcom,mdss-dsi-te-check-enable;
		qcom,mdss-dsi-te-using-te-pin;
		qcom,mdss-dsi-lp11-init;
		//qcom,mdss-dsi-pixel-packing = "loose";
	    qcom,mdss-dsi-high-brightness-panel;
		qcom,mdss-dsi-acl-cmd-index = <0>;
		qcom,mdss-dsi-acl-mode-index = <1>;
		qcom,mdss-bl-high2bit;							
		qcom,mdss-dsi-panel-jitter = <0x8 0xa>;	
		qcom,mdss-dsi-display-timings {
			timing@0{
				qcom,mdss-dsi-panel-framerate = <60>;
				qcom,mdss-dsi-panel-width = <1440>;
				qcom,mdss-dsi-panel-height = <3120>;
				qcom,mdss-dsi-h-front-porch = <116>;
				qcom,mdss-dsi-h-back-porch = <120>;
				qcom,mdss-dsi-h-pulse-width = <44>;
				qcom,mdss-dsi-h-sync-skew = <0>;
				qcom,mdss-dsi-v-back-porch = <124>;
				qcom,mdss-dsi-v-front-porch = <120>;
				qcom,mdss-dsi-v-pulse-width = <80>;
				qcom,mdss-dsi-h-left-border = <0>;
				qcom,mdss-dsi-h-right-border = <0>;
				qcom,mdss-dsi-v-top-border = <0>;
				qcom,mdss-dsi-v-bottom-border = <0>;
				qcom,mdss-dsi-panel-jitter = <0x8 0xa>;			
				qcom,mdss-dsi-bl-pmic-control-type = "bl_ctrl_dcs";
				qcom,mdss-dsi-on-command = [
					/*
				07 01 00 00 00 00 01 01 		
				29 01 00 00 00 00 5A 0A
				10 00 00 89 30 80 0C 30 
				05 A0 00 41 02 D0 02 D0 
				02 00 02 C2 00 20 06 58
				00 0A 00 0F 01 E0 01 2D 
				18 00 10 F0 03 0C 20 00
				06 0B 0B 33 0E 1C 2A 38 
				46 54 62 69 70 77 79 7B
				7D 7E 01 02 01 00 09 40 
				09 BE 19 FC 19 FA 19 F8 
				1A 38 1A 78 1A B6 2A B6 
				2A F4 2A F4 4B 34 63 74 
				00	
				05 01 00 00 16 00 01 11	
				15 00 00 00 00 00 02 35 00
				39 01 00 00 00 00 05 2A 00 00 05 9F
				39 01 00 00 00 00 05 2B 00 00 0C 2F
				39 01 00 00 00 00 03 F0 5A 5A
				39 01 00 00 00 00 0a B9 01 B0 81 09 00 00 00 11 03
				39 01 00 00 00 00 03 F0 A5 A5					
				29 01 00 00 00 00 03 F0 5A 5A
				15 01 00 00 00 00 02 B0 05
				15 01 00 00 00 00 02 B1 01
				15 01 00 00 00 00 02 B0 02
				15 01 00 00 00 00 02 B5 93
				29 01 00 00 00 00 03 F0 A5 A5
				15 01 00 00 00 00 02 53 20
				15 01 00 00 00 00 02 55 00
				05 01 00 00 00 00 01 29 
				*/
							07 01 00 00 00 00 01 01 		
				29 01 00 00 00 00 5A 0A
				10 00 00 89 30 80 0C 30 
				05 A0 00 41 02 D0 02 D0 
				02 00 02 C2 00 20 06 58
				00 0A 00 0F 01 E0 01 2D 
				18 00 10 F0 03 0C 20 00
				06 0B 0B 33 0E 1C 2A 38 
				46 54 62 69 70 77 79 7B
				7D 7E 01 02 01 00 09 40 
				09 BE 19 FC 19 FA 19 F8 
				1A 38 1A 78 1A B6 2A B6 
				2A F4 2A F4 4B 34 63 74 
				00	
				



				    //29 01 00 00 00 00 03 9F A5 A5
					05 01 00 00 78 00 01 11	
					//29 01 00 00 00 00 03 9F 5A 5A



					
   




				


					/* Common Setting */
					//29 01 00 00 00 00 03 9F A5 A5
					15 00 00 00 00 00 02 35 00		/* TE Vsync ON */
					//29 01 00 00 00 00 03 9F 5A 5A

				    /*CASET/PASET*/
					39 01 00 00 00 00 05 2A 00 00 05 9F
					39 01 00 00 00 00 05 2B 00 00 0C 2F
					/*TSP H_sync Setting*/
					39 01 00 00 00 00 03 F0 5A 5A
					39 01 00 00 00 00 0a B9 01 B0 81 09 00 00 00 11 03
					39 01 00 00 00 00 03 F0 A5 A5
					
				//	29 01 00 00 00 00 03 F0 5A 5A
				//	15 01 00 00 00 00 02 B0 05
				//	15 01 00 00 00 00 02 B1 01
				//	15 01 00 00 00 00 02 B0 02
				//	15 01 00 00 00 00 02 B5 93
				//	29 01 00 00 00 00 03 F0 A5 A5
				

					39 01 00 00 00 00 02 53 20

			

					//	15 01 00 00 00 00 02 55 00

				//	39 01 00 00 00 00 03 F0 5A 5A
				//	39 01 00 00 00 00 02 9D 01
				//	39 01 00 00 00 00 03 F0 A5 A5
					

			
				/*Display on*/
				//29 01 00 00 00 00 03 9F A5 A5
				05 01 00 00 00 00 01 29 
				//29 01 00 00 00 00 03 9F 5A 5A
];
				qcom,mdss-dsi-on-command-state = "dsi_lp_mode";
				qcom,mdss-dsi-off-command-state = "dsi_hs_mode";
				qcom,mdss-dsi-h-sync-pulse = <0>;
				
				qcom,mdss-dsi-off-command=[
					05 01 00 00 00 00 02 28 00
					29 01 00 00 00 00 03 9F A5 A5		
					05 01 00 00 00 00 02 10 00		
					29 01 00 00 B4 00 03 9F 5A 5A	
				];
				qcom,partial-update-enabled = "single_roi";
				qcom,panel-roi-alignment=<720 65 720 65 720 65>;
				qcom,compression-mode = "dsc";
				qcom,lm-split = <720 720>;
				qcom,mdss-dsc-encoders = <2>;
				qcom,mdss-dsc-slice-height = <65>;
				qcom,mdss-dsc-slice-width = <720>;
				qcom,mdss-dsc-slice-per-pkt = <2>;
				qcom,mdss-dsc-bit-per-component = <8>;
				qcom,mdss-dsc-bit-per-pixel = <8>;
				qcom,mdss-dsc-block-prediction-enable;				
				};
		};
	};
};



