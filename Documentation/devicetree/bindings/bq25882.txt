## Documentation/devicetree/bindings/bq25882.txt
```
"ti,bq25882-charger"



Required properties:

- compatible : should be "microchip,oneplus_fastchg"


Example:
	bq25882-charger@6b {

               status = "ok";

               compatible = "ti,bq25882-charger";

               reg = <0x6b>;
```

## Documentation/devicetree/bindings/da9313.txt
```
dlg,da9313-divider



Required properties:

- compatible : should be "dlg,da9313-divider"


Example:

           da9313-divider@68 {

           status = "ok";

           compatible = "dlg,,da9313-divider";

           reg = <0x68>;
```

## coretech/Kconfig
```kconfig
config OPCHAIN
	default n
	bool "Oneplus CoreTech helper, used for opchain module"
config SMART_BOOST
        bool "support smart boost feature"
        default n
        help
         Smart Boost feature
```

## drivers/oneplus/coretech/Kconfig
```kconfig
config OPCHAIN
	default n
	bool "Oneplus CoreTech helper, used for opchain module"

config DEFRAG_HELPER
	default n
	bool "Oneplus CoreTech helper, used for defrag module"

config CRPL_HELPER
	default n
	bool "Oneplus CoreTech helper, used for crpl module"
```
